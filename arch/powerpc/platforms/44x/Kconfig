## arch/powerpc/platforms/44x/Kconfig
```kconfig
#config BAMBOO
#	bool "Bamboo"
#	depends on 44x
#	default n
#	select 440EP
#	help
#	  This option enables support for the IBM PPC440EP evaluation board.

config EBONY
	bool "Ebony"
	depends on 44x
	default y
	select 440GP
	help
	  This option enables support for the IBM PPC440GP evaluation board.

config BGP
	bool "Blue Gene/P"
	depends on 44x
	default n
	select BLUEGENE
	select PPC_FPU
	select IBM_NEW_EMAC_XEMAC
	select IBM_NEW_EMAC_XGMII
	select IBM_NEW_EMAC_TOMAL
	select BGIC
	select DEFAULT_UIMAGE
	help
	  This option enables support for the IBM Blue Gene/P supercomputer.

#config LUAN
#	bool "Luan"
#	depends on 44x
#	default n
#	select 440SP
#	help
#	  This option enables support for the IBM PPC440SP evaluation board.

#config OCOTEA
#	bool "Ocotea"
#	depends on 44x
#	default n
#	select 440GX
#	help
#	  This option enables support for the IBM PPC440GX evaluation board.

# 44x specific CPU modules, selected based on the board above.
config 440EP
	bool
	select PPC_FPU
	select IBM440EP_ERR42

config 440GP
	bool
	select IBM_NEW_EMAC_ZMII

config 440GX
	bool

config 440SP
	bool

config 440A
	bool
	depends on 440GX
	default y

# 44x errata/workaround config symbols, selected by the CPU models above
config IBM440EP_ERR42
	bool

config BLUEGENE
	bool

config L1_WRITETHROUGH
	bool "Blue Gene enable L1 writethrough mode"
	depends on BGP
	default y

config TLBIE_LOCAL_ONLY
	bool
	depends on SMP && BLUEGENE
	default y

config ICBI_LOCAL_ONLY
	bool
	depends on SMP && BLUEGENE
	default y
```

## drivers/bluegene/Kconfig
```kconfig
menu "BlueGene device support"
	depends on BGP

config BGP_NETWORK
	bool "Blue Gene network support for torus and tree"
	---help---
	  Support for the internal Blue Gene networks as first-class
          Linux devices.

endmenu
```
